## drivers/input/fingerprint/Kconfig
```kconfig
#
# Input device configuration
config FINGERPRINT_FPC
	tristate "fingerprint fpc"
	default y
	help
	  Say Y here if you have a fpc
          If unsure, say N.
source "drivers/input/fingerprint/fpc/Kconfig"


config CHIPONE_FINGERPRINT
	tristate "fingerprint chipone"
	default y
	help
	  Say Y here if you have a chipone
          If unsure, say N.
source "drivers/input/fingerprint/fpc/Kconfig"
```
